
#include <Max3421e.h>
#include <Usb.h>
#include <AndroidAccessory.h>

// デジタル出力ピンの定義
#define DOUT0 2
#define DOUT1 3
#define DOUT2 4
#define DOUT3 5

// 赤外線信号出力
#define IR_OUT DOUT1

// サンヨーエアコン
int DATA_AC_ON[] = {3416,1540,532,388,476,336,516,336,516,344,496,376,476,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500, 0};
int DATA_AC_OFF[] = {3416,1556,532,340,516,336,524,328,520,332,512,332,520,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492, 0};

// プロトコル定義
#define START_BYTE 0x7f
#define CMD_AC_CTRL 0x02
#define CMD_TV_CTRL 0x03
#define MAX_MSG_SIZE 5

AndroidAccessory acc("MyManufacturer",
		     "IrRemoteControler",
		     "Android Open Accessory basic implementation",
		     "1.0",
		     "http://android.com",
		     "0000000012345678");

// メッセージバッファ
byte msg[MAX_MSG_SIZE];

void initPins()
{
  // デジタル出力ピンの初期化
  pinMode(DOUT0, OUTPUT);
  pinMode(DOUT1, OUTPUT);
  pinMode(DOUT2, OUTPUT);
  pinMode(DOUT3, OUTPUT);
  digitalWrite(DOUT0, LOW);
  digitalWrite(DOUT1, LOW);
  digitalWrite(DOUT2, LOW);
  digitalWrite(DOUT3, LOW);
}

void setup()
{
  Serial.begin(115200);
  Serial.print("\r\nStart");

  // 各入出力ピンの初期化を行う
  initPins();
    
  // アクセサリの電源ON
  acc.powerOn();
}


void loop()
{
  int b = 0;
  uint16_t val = 0;

  if (acc.isConnected()) {
    //
    // 受信処理
    //
    int len = acc.read(msg, sizeof(msg), 1);
    int i;

    if (msg[0] == START_BYTE && len >= msg[1]) {
      Serial.print("receive cmd:");
      Serial.print(msg[2], HEX);
      Serial.print("\r\n");

      switch (msg[2]) {
      case CMD_AC_CTRL:
        if (msg[3]) {
          sendIr(DATA_AC_ON, sizeof(DATA_AC_ON)/sizeof(DATA_AC_ON[0]));
        } else {
          sendIr(DATA_AC_OFF, sizeof(DATA_AC_OFF)/sizeof(DATA_AC_OFF[0]));
        }
        break;
      default:
	break;
      }
    }
  } else {
    // 接続が切れた場合、出力値をリセットする
    digitalWrite(DOUT0, LOW);
    digitalWrite(DOUT1, LOW);
    digitalWrite(DOUT2, LOW);
    digitalWrite(DOUT3, LOW);
  }
  delay(10);
}


//
// irDataからリモコン信号を送信
//
void sendIr(int *irData, int size) {
  Serial.print(size, DEC);
  for (int i = 0; i < size; i++) {
    Serial.print(".");
    unsigned long len = irData[i];
//    if (len == 0) break;      // 0なら終端。
    unsigned long startTime = micros();
    do {
      digitalWrite(IR_OUT, 0x1 - (i & 0x1)); // iが偶数なら赤外線ON、奇数なら0のOFFのまま
      delayMicroseconds(8);  // キャリア周波数38kHzでON/OFFするよう時間調整
      digitalWrite(IR_OUT, 0);
      delayMicroseconds(18);
    } while (long(startTime + len - micros()) > 0); // 送信時間に達するまでループ
  }
  Serial.print("OK\n");
}

